## xiaozhi-esp32/sdkconfig.defaults
```kconfig
CONFIG_BOARD_TYPE_OTTO_ROBOT=y
# CONFIG_BOARD_TYPE_BREAD_COMPACT_WIFI is not set
CONFIG_HTTPD_WS_SUPPORT=y

# 锁定使用 16MB 分区和自定义分区表
CONFIG_ESPTOOLPY_FLASHSIZE_16MB=y
CONFIG_ESPTOOLPY_FLASHSIZE="16MB"
CONFIG_PARTITION_TABLE_CUSTOM=y
CONFIG_PARTITION_TABLE_CUSTOM_FILENAME="partitions/v2/16m.csv"
CONFIG_PARTITION_TABLE_FILENAME="partitions/v2/16m.csv"

# 【核心修复】强制使用官方默认资源（包含中文字库、表情、默认你好小智唤醒模型）
CONFIG_FLASH_DEFAULT_ASSETS=y
CONFIG_USE_DEFAULT_ASSETS=y

# 强制开启中文相关模型
CONFIG_SR_MN_CN_MULTINET7_QUANT=y
CONFIG_USE_AFE_WAKE_WORD=y
CONFIG_USE_WAKENET=y
CONFIG_SR_WN_WN9_NIHAOXIAOZHI_TTS=y
```

## xiaozhi-esp32/sdkconfig.defaults.esp32s3
```kconfig
CONFIG_IDF_TARGET="esp32s3"
CONFIG_BOARD_TYPE_OTTO_ROBOT=y
CONFIG_HTTPD_WS_SUPPORT=y

CONFIG_ESPTOOLPY_FLASHSIZE_16MB=y
CONFIG_ESPTOOLPY_FLASHSIZE="16MB"
CONFIG_PARTITION_TABLE_CUSTOM=y
CONFIG_PARTITION_TABLE_CUSTOM_FILENAME="partitions/v2/16m.csv"
CONFIG_PARTITION_TABLE_FILENAME="partitions/v2/16m.csv"

CONFIG_ESPTOOLPY_FLASHMODE_DIO=y
CONFIG_ESPTOOLPY_FLASHFREQ_40M=y

CONFIG_SPIRAM=y
CONFIG_SPIRAM_MODE_OCT=y
CONFIG_SPIRAM_SPEED_80M=y
CONFIG_SPIRAM_USE_MALLOC=y
CONFIG_LV_MEM_CUSTOM=y
CONFIG_LV_MEM_CUSTOM_INCLUDE="stdlib.h"

CONFIG_FLASH_DEFAULT_ASSETS=y
CONFIG_USE_DEFAULT_ASSETS=y
CONFIG_LANGUAGE_ZH_CN=y

# 回归官方最稳唤醒
CONFIG_USE_AFE_WAKE_WORD=y
CONFIG_USE_WAKENET=y
CONFIG_SR_WN_WN9_NIHAOXIAOZHI_TTS=y
CONFIG_USE_CUSTOM_WAKE_WORD=n
CONFIG_SR_MN_CN_MULTINET7_QUANT=n
```
